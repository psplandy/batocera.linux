## package/batocera/boot/uboot-sunxi-r16/Config.in
```kconfig
config BR2_PACKAGE_UBOOT_SUNXI_R16
    bool "uboot files for Allwinner/Sunxi R16"
    select BR2_TOOLCHAIN_OPTIONAL_LINARO_ARM
    help
        uboot files for Allwinner/Sunxi R16
```

## package/batocera/controllers/e2m-paddle-trackball/Config.in
```kconfig
config BR2_PACKAGE_E2M_PADDLE_TRACKBALL
	bool "Taito Egret-II Mini Paddle and Trackball controller support"
	select BR2_PACKAGE_EVSIEVE

	help
	  Egret-II Mini Paddle Trackball support
```
